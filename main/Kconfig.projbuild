## main/Kconfig.projbuild
```kconfig
menu "artlight Configuration"

config OTA_URL
    string "Over the Air (OTA) Software Update URL"
    default "https://artlightserver:4433/artlight.bin"
    help
        URL of the service that provides our software update.

config TIME_SERVERS
    string "SNTP Time Servers"
    default "0.us.pool.ntp.org 1.us.pool.ntp.org 2.us.pool.ntp.org"
    help
        Whitespace delimited names of SNTP servers.

config TIME_ZONE
    string "Time Zone"
    default "PST+8PDT,M3.2.0/2,M11.1.0"
    help
       https://www.gnu.org/software/libc/manual/html_node/TZ-Variable.html
endmenu
```

## project/sdkconfig.defaults
```kconfig
CONFIG_COMPILER_CXX_EXCEPTIONS=y

CONFIG_ESP_MAIN_TASK_STACK_SIZE=8192

CONFIG_ESP32_DEFAULT_CPU_FREQ_240=y

CONFIG_ESPTOOLPY_FLASHSIZE_4MB=y

CONFIG_FREERTOS_TIMER_TASK_STACK_DEPTH=4096

CONFIG_HTTPD_MAX_REQ_HDR_LEN=1024

CONFIG_LOG_DEFAULT_LEVEL_INFO=y
# CONFIG_LOG_DEFAULT_LEVEL_DEBUG=y

CONFIG_LWIP_DHCP_MAX_NTP_SERVERS=8
CONFIG_LWIP_MAX_SOCKETS=16
CONFIG_LWIP_UDP_RECVMBOX_SIZE=20

CONFIG_PARTITION_TABLE_TWO_OTA=y
CONFIG_PARTITION_TABLE_CUSTOM=y
CONFIG_PARTITION_TABLE_CUSTOM_FILENAME="partitions.csv"
```

## sdkconfig.defaults
```kconfig
# Default sdkconfig parameters to use the OTA
# partition table layout, with a 4MB flash size
CONFIG_ESPTOOLPY_FLASHSIZE_4MB=y
CONFIG_PARTITION_TABLE_TWO_OTA=y

CONFIG_LWIP_DHCP_MAX_NTP_SERVERS=8

CONFIG_PARTITION_TABLE_CUSTOM=y
CONFIG_PARTITION_TABLE_FILENAME="partitions.csv"

CONFIG_CXX_EXCEPTIONS=y
CONFIG_CXX_EXCEPTIONS_EMG_POOL_SIZE=0

CONFIG_ESPTOOLPY_BAUD_921600B=y
CONFIG_ESPTOOLPY_BAUD=921600

CONFIG_ESP32_DEFAULT_CPU_FREQ_240=y
CONFIG_ESP32_DEFAULT_CPU_FREQ_MHZ=240

CONFIG_HTTPD_MAX_REQ_HDR_LEN=1024

CONFIG_MAIN_TASK_STACK_SIZE=8192

CONFIG_UDP_RECVMBOX_SIZE=20

CONFIG_LWIP_MAX_SOCKETS=16

CONFIG_TIMER_TASK_STACK_DEPTH=4096
```
